// generated by mBlock5 for mBot Ranger
// codes make you happy
 
#include <Arduino.h>
#include <Wire.h>
#include <SoftwareSerial.h>
#include <MeAuriga.h>
 
MeLightSensor lightsensor_12(12);
 
Me4Button buttonSensor_8(8);
MeDCMotor motor_3(3);
MeDCMotor motor_4(4);
 
void _delay(float seconds) {
 if(seconds < 0.0){
   seconds = 0.0;
 }
 long endTime = millis() + seconds * 1000;
 while(millis() < endTime) _loop();
}
 
void setup() {
 randomSeed((unsigned long)(lightsensor_12.read() * 123456));
 while(1) {
     if((buttonSensor_8.pressed()==1)){
         motor_3.run(-1*50/100.0*255);
         motor_4.run(-1*50/100.0*255);
         _delay(3.5);
         motor_3.run(1*0/100.0*255);
         motor_4.run(1*0/100.0*255);
 
     }
     if((buttonSensor_8.pressed()==2)){
         motor_4.run(1*50/100.0*255);
         motor_3.run(1*50/100.0*255);
         _delay(3.5);
         motor_3.run(1*0/100.0*255);
         motor_4.run(1*0/100.0*255);
 
     }
 
     _loop();
 }
 
}
 
void _loop() {
 buttonSensor_8.pressed();
}
 
void loop() {
 _loop();
}



